## config/west.yml
```yaml
manifest:
  remotes:
    - name: zmkfirmware
      url-base: https://github.com/zmkfirmware
    # - name: gpeye
    #   url-base: https://github.com/GPeye
    - name: englmaxi
      url-base: https://github.com/englmaxi
    - name: kroleg
      url-base: https://github.com/kroleg
  projects:
    # - name: hammerbeam-slideshow
    #   remote: gpeye
    #   revision: main
    - name: zmk
      remote: zmkfirmware
      revision: v0.3.0
      import: app/west.yml
    - name: zmk-dongle-display
      remote: kroleg
      revision: layer-name-width
  self:
    path: config
```
